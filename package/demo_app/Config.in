## package/demo_app/Config.in
```kconfig
config BR2_PACKAGE_DEMO_APP
	bool "LED/Switch demo application"
	depends on BR2_PACKAGE_LEDBLK
	depends on BR2_PACKAGE_SWITCHBLK
	help
	  User-space demo application that reads data from
	  switchblk character driver and writes it to
	  ledblk character driver.
```

## package/ledblk/Config.in
```kconfig
config BR2_PACKAGE_LEDBLK
	bool "ledblk character driver"
	depends on BR2_LINUX_KERNEL
	help
	  LEDBLK is a RAM-backed character device driver
	  with full file_operations support, procfs and sysfs
	  interfaces.
```

## package/switchblk/Config.in
```kconfig
config BR2_PACKAGE_SWITCHBLK
	bool "switchblk character driver"
	depends on BR2_LINUX_KERNEL
	help
	  SWITCHBLK is a RAM-backed character device driver
	  with full file_operations support, procfs and sysfs
	  interfaces.
```
